## conf/layer.conf
```bitbake
# We have a conf directory, add to BBPATH
BBPATH .= ":${LAYERDIR}"

# We have recipes-* directories, add to BBFILES
BBFILES += "\
            ${LAYERDIR}/recipes-*/*/*.bb \
            ${LAYERDIR}/recipes-*/*/*.bbappend \
           "

# Yocto porting layer's configurations
BBFILE_COLLECTIONS += "aa"
BBFILE_PATTERN_aa := "^${LAYERDIR}/"
BBFILE_PRIORITY_aa = "11"

# 'Vsomeip' software package from 'meta-ara' layer uses 'boost' version '1.64.0'.
# Due to upgrading poky from sumo to zeus, version of boost has been updated
# to '1.71.0' causing errors at compile time.
# Therefore, we use version '1.64.0' of 'boost', instead of the version provided
# by 'poky/meta' layer.
PREFERRED_VERSION_boost = "1.71.0"
PREFERRED_VERSION_bjam-native = "1.71.0"

# We set the provider for 'gtest' package to be 'meta-ara' layer.
PREFERRED_PROVIDER_gtest = "gtest"

# mkfifo executable is not added into HOSTTOOLS variable by any other layer
# from the present configuration.
# ComputerVision application from meta-st layer uses it to create
# named pipes at install stage. In order to avoid any error in building
# system testing Adaptive Autosar images from meta-st layer, we add this
# executable into HOSTTOOLS variable.
HOSTTOOLS_append = " mkfifo"

# Set 'LAYERSERIES_COMPAT' variable to match the version 'zeus'
# of OpenEmbedded-Core
LAYERSERIES_COMPAT_aa = "zeus gatesgarth"

ADAPTIVE_AUTOSAR_VERSION = "R20-11"

# Enable SysVInit init manager
DISTRO_FEATURES_remove = " systemd"
DISTRO_FEATURES_BACKFILL_CONSIDERED_remove = " sysvinit"
VIRTUAL-RUNTIME_init_manager = "sysvinit"
VIRTUAL-RUNTIME_initscripts = "initscripts"

# Add support for SJA1105 swich under Linux
CORE_IMAGE_EXTRA_INSTALL_append_s32v234evb = " sja1105"
CORE_IMAGE_EXTRA_INSTALL_append_s32v234bbmini = " sja1105"
```
